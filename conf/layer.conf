## conf/layer.conf
```bitbake
# We have a conf and classes directory, add to BBPATH
BBPATH .= ":${LAYERDIR}"

# We have recipes-* directories, add to BBFILES
BBFILES += "${LAYERDIR}/recipes-*/*/*.bb \
	${LAYERDIR}/recipes-*/*/*.bbappend"

BBFILE_COLLECTIONS += "meta-cx1-influx"
BBFILE_PATTERN_meta-cx1-influx = "^${LAYERDIR}/"
BBFILE_PRIORITY_meta-cx1-influx = "6"
```
